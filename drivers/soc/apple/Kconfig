## drivers/soc/apple/Kconfig
```kconfig
# SPDX-License-Identifier: GPL-2.0-only

if ARCH_APPLE || COMPILE_TEST

menu "Apple SoC drivers"

config APPLE_PMGR_PSTATE
	tristate "Apple SoC PMGR power state control"
	select REGMAP
	select MFD_SYSCON
	select PM_GENERIC_DOMAINS
	default ARCH_APPLE
	help
	  The PMGR block in Apple SoCs provides high-level power state
	  controls for SoC devices. This driver manages them through the
	  generic power domain framework.

endmenu

endif
```
